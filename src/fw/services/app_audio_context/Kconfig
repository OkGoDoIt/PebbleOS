## src/fw/services/app_audio_context/Kconfig
```kconfig
# SPDX-License-Identifier: Apache-2.0

config SERVICE_APP_AUDIO_CONTEXT
    bool "App audio context endpoint"
    default y if SERVICE_COMM_SESSION
    depends on SERVICE_COMM_SESSION
    help
      Private watch app endpoint for permissioned audio context SDK requests.
```

## src/fw/services/background_audio/Kconfig
```kconfig
# SPDX-FileCopyrightText: 2026 Core Devices LLC
# SPDX-License-Identifier: Apache-2.0

config SERVICE_BACKGROUND_AUDIO
    bool "Background audio lifelogging"
    default y if SERVICE_VOICE && SERVICE_AUDIO_ENDPOINT
    depends on SERVICE_VOICE && SERVICE_AUDIO_ENDPOINT && MIC
    help
      Continuous watch microphone streaming to the connected phone over the
      private audio endpoint. Requires voice/Speex and audio endpoint services.
```
