## fw/apps/demo/muse_setup_test/Kconfig
```kconfig
# SPDX-License-Identifier: Apache-2.0

config DEMO_APP_MUSE_SETUP_TEST
    bool "Muse Setup Test"
    depends on BT_MUSE_SETUP_SERVICE
    help
      Opens the Muse gadget setup window from the watch and shows what the
      second, private link does (discovery, connection, identity, MTU,
      writes echoed back), for checking it with a generic BLE app before the
      companion app relays the setup.
```

## fw/services/peek_widgets/Kconfig
```kconfig
# SPDX-FileCopyrightText: 2026 Core Devices LLC
# SPDX-License-Identifier: Apache-2.0

config SERVICE_PEEK_WIDGETS
    bool "Quick View widgets"
    depends on SERVICE_TIMELINE && SERVICE_NOTIFICATIONS && SERVICE_MUSIC
    help
      Generalizes the Timeline Quick View overlay into a contextual widget
      surface: now-playing music, recently arrived notifications, and
      app-published widgets can peek at the bottom of the watchface, with a
      configurable down-button shortcut that launches the widget's app.

if SERVICE_PEEK_WIDGETS

module = SERVICE_PEEK_WIDGETS
module-str = PeekWidgets
source "subsys/logging/Kconfig.template.log_level"

endif
```

## src/fw/drivers/mic/Kconfig
```kconfig
# SPDX-FileCopyrightText: 2026 Core Devices LLC
# SPDX-License-Identifier: Apache-2.0

menuconfig MIC
    bool "Microphone"
    help
      Microphone Drivers

if MIC

config MIC_NRF5
    bool "Nordic nRF5 PDM"
    default y if SOC_NRF52
    select HAL_NORDIC
    help
      Support for the Nordic nRF5 PDM microphone interface.

config MIC_SF32LB
    bool "SiFli SF32LB PDM"
    default y if SOC_SF32LB52
    select HAL_SIFLI
    select HAL_SIFLI_AUDCODEC
    select HAL_SIFLI_PDM
    help
      Support for the SiFli SF32LB PDM microphone interface.

config MIC_SF32LB_CAPTURE_DEEP_WFI
    bool "Allow deep WFI while the SF32LB microphone is capturing"
    depends on MIC_SF32LB
    help
      By default the PDM driver forbids deep WFI for the whole of a capture,
      so the core idles in plain WFI with the 240 MHz DLL and the full-speed
      bus clocks running for as long as the microphone is on. With this set
      the driver asks the SoC for its audio deep-WFI profile instead (HCLK
      held at the 48 MHz deep-WFI source and the HP clock forced on -- the
      recipe the vendor SDK uses for its own audio scenario) and only forbids
      deep sleep, which would power HPSYS and the PDM down. Off by default
      until it has been characterised on every SF32LB board; the audio
      companion selects it.

config MIC_QEMU
    bool "QEMU stub"
    default y if SOC_QEMU
    help
      Software-only microphone stub for QEMU. Delivers silence at
      MIC_SAMPLE_RATE so the voice service can run end-to-end against
      `pebble transcribe`, which ignores audio frames and replies with
      a canned transcription on a timer.

module = DRIVER_MIC
module-str = Microphone
source "subsys/logging/Kconfig.template.log_level"

endif # MIC
```

## src/fw/services/audio_companion/Kconfig
```kconfig
# SPDX-License-Identifier: Apache-2.0

config SERVICE_AUDIO_COMPANION
    bool "Audio companion background streaming"
    depends on MIC && SERVICE_VOICE
    select AUDIO_COMPANION_SERVICE_ENABLED if BT_FW_NIMBLE
    select MBEDTLS
    select MIC_SF32LB_CAPTURE_DEEP_WFI if MIC_SF32LB
    help
      Background microphone streaming to an authorized third-party audio
      companion app over a dedicated watch-hosted GATT service. The
      transport requires a NimBLE Bluetooth backend; on other backends the
      service compiles but stays inert.

      MBEDTLS is selected for the receiver registry's SHA-256 (see
      pebble_mbedtls_config.h, which enables the primitive only when this
      symbol is set). NimBLE selects it too; the select makes the
      dependency hold on the other backends as well.

      MIC_SF32LB_CAPTURE_DEEP_WFI is selected again: it is the single
      largest power win available to a background recorder (the core
      otherwise idles in plain WFI with the 240 MHz DLL and full-speed bus
      clocks up for the whole of every capture). The first firmware to
      carry it on a wrist (v4.36.0-282, 2026-09-09) restarted the watch
      five times in three hours and it was switched off on suspicion. The
      watch then hard-faulted again WITHOUT it (v4.36.0-287, 2026-09-10),
      and the trace named the real cause: a double free in the notify path
      on every refused notification, present since the service's first
      commit and fixed in v4.36.0-288, which has since run three days with
      no fault restart. Deep WFI is exonerated of the crashes; what it has
      never had is a measured watch %/h on a wrist, which is what the first
      build carrying this line exists to produce. If audio is garbled or
      the log shows "Dropping N bytes of old audio", or the fault counter
      moves, CONFIG_MIC_SF32LB_CAPTURE_DEEP_WFI=n restores plain-WFI
      capture in one line.

if SERVICE_AUDIO_COMPANION

module = SERVICE_AUDIO_COMPANION
module-str = Audio companion
source "subsys/logging/Kconfig.template.log_level"

config AUDIO_COMPANION_SPOOL_MIN_BYTES
    int "Audio companion spool floor (bytes)"
    default 8192
    help
      The spool may always grow to at least this many bytes of encoded
      audio, regardless of heap pressure.

config AUDIO_COMPANION_SPOOL_MAX_BYTES
    int "Audio companion spool ceiling (bytes)"
    default 131072
    help
      Hard upper bound on opportunistic spool memory. The spool may grow toward
      this ceiling only while the kernel heap reserve below is still available;
      on tighter devices the effective capacity is lower.

config AUDIO_COMPANION_SPOOL_HEAP_RESERVE_BYTES
    int "Kernel heap headroom the spool must always leave free"
    default 32768
    help
      The spool only grows while at least this much kernel heap stays free after
      another chunk-sized allocation, and sheds optional chunks when free heap
      drops below it.

config AUDIO_COMPANION_LOW_BATTERY_PERCENT
    int "Pause streaming below this battery percent"
    default 20

endif # SERVICE_AUDIO_COMPANION
```

## subsys/bluetooth/services/audio_companion/Kconfig
```kconfig
# SPDX-FileCopyrightText: 2026 Core Devices LLC
# SPDX-License-Identifier: Apache-2.0

config BT_SERVICE_AUDIO_COMPANION
    bool "Audio Companion GATT service"
    help
      Build the dedicated watch-hosted Audio Companion GATT service used by
      custom firmware to stream background microphone audio to a separate
      third-party mobile app.
```

## subsys/bluetooth/services/muse_setup/Kconfig
```kconfig
# SPDX-FileCopyrightText: 2026 Core Devices LLC
# SPDX-License-Identifier: Apache-2.0

config BT_SERVICE_MUSE_SETUP
    bool "Muse gadget setup service"
    depends on BT_SERVICE_AUDIO_COMPANION
    help
      Host Meta's Muse gadget BLE setup service for a short pairing window,
      on a second, private connection from a random static address, so the
      Muse app on the phone the watch is already connected to can pair the
      companion app as a Muse gadget. Allows two connections. Needs a public
      identity address. Off by default.
```

## third_party/nimble/Kconfig
```kconfig
# SPDX-FileCopyrightText: 2026 Core Devices LLC
# SPDX-License-Identifier: Apache-2.0

menu "NimBLE BLE stack"

choice
    prompt "SF32LB52 HCI trace"
    default NIMBLE_HCI_SF32LB52_TRACE_NONE
    depends on BT_HCI_SF32LB52
    help
      Trace mode for the SF32LB52 HCI transport.

config NIMBLE_HCI_SF32LB52_TRACE_NONE
    bool "Disabled"

config NIMBLE_HCI_SF32LB52_TRACE_BINARY
    bool "Binary"
    help
      Capture raw HCI traffic in a binary format suitable for offline
      decoding.

config NIMBLE_HCI_SF32LB52_TRACE_LOG
    bool "Log"
    help
      Emit human-readable HCI trace lines through the standard logger.

config NIMBLE_HCI_SF32LB52_TRACE_EVENTS
    bool "Events and commands only"
    help
      Log one line per HCI command and per HCI event (except Number Of
      Completed Packets) at INFO level in the NimBLE module, without
      payloads or ACL data. Cheap enough to leave on while a phone link
      streams; shows what the controller reported about advertising,
      connections and their failures.

endchoice

choice "NIMBLE_LOG_LEVEL_CHOICE"
    default NIMBLE_LOG_LEVEL_OFF
endchoice

module = NIMBLE
module-str = NimBLE host
source "subsys/logging/Kconfig.template.log_level"

# NimBLE's own options, generated from its syscfg.yml files by
# scripts/gen_syscfg.py. PebbleOS-wide values live in
# subsys/bluetooth/Kconfig.defconfig, per-SoC ones in soc/*/Kconfig.defconfig.
rsource "Kconfig.ble"
rsource "Kconfig.host"
rsource "Kconfig.svcs"
rsource "Kconfig.transport"
rsource "Kconfig.controller"
rsource "Kconfig.drivers"
rsource "Kconfig.port"

endmenu
```
